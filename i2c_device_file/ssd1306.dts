/dts-v1/;
/plugin/;

/ {
	compatible = "brcm,bcm2835";

	fragment@0{
		target = <&i2c1>;
		__overlay__ {
			#address-cells = <1>;
			#size-cells = <0>;

		ssd1306@3c {
			compatible = "ds3231, ds32";
			reg = <0x3c>;
		};
	};
};
};
			
