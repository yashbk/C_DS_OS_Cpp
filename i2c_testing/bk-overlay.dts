/dts-v1/;
/plugin/;

/ {
    compatible = "brcm,bcm2835";

    fragment@0 {
        target = <&i2c1>; // Assuming I2C1 is being used
        __overlay__ {
            #address-cells = <1>;
            #size-cells = <0>;
            status = "okay";

            ssd1306: ssd1306@3c {
                compatible = "solomon,ssd1306";
                reg = <0x3c>;
            };
        };
    };
};
